## firmware-release-gate/sample/sdkconfig.defaults
```kconfig
# ESP-IDF release defaults for the gateway board (copied from the bring-up branch)
CONFIG_IDF_TARGET="esp32s3"
CONFIG_ESPTOOLPY_FLASHSIZE_8MB=y
CONFIG_PARTITION_TABLE_CUSTOM=y
CONFIG_PARTITION_TABLE_CUSTOM_FILENAME="partitions.csv"

# Security
# CONFIG_SECURE_BOOT is not set
CONFIG_SECURE_FLASH_ENC_ENABLED=y
CONFIG_SECURE_FLASH_ENCRYPTION_MODE_DEVELOPMENT=y
CONFIG_SECURE_BOOT_ALLOW_JTAG=y
# CONFIG_NVS_ENCRYPTION is not set

# Networking / OTA
CONFIG_ESP_HTTPS_OTA_ALLOW_HTTP=y
CONFIG_APP_OTA_URL="http://updates.example.com/gateway/firmware.bin"

# Diagnostics
CONFIG_LOG_DEFAULT_LEVEL=4
CONFIG_ESP_SYSTEM_PANIC_GDBSTUB=y
CONFIG_COMPILER_OPTIMIZATION_DEBUG=y
```
