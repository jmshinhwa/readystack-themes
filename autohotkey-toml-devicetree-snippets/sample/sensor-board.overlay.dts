/dts-v1/;
/plugin/;

/ {
	fragment@0 {
		target = <&i2c1>;
		__overlay__ {
			status = "ok";
			#address-cells = <1>;
			#size-cells = <0>;

			temp_sensor@48 {
				compatible = "ti,tmp102"
				reg = <0x48>;
				status = "okay";
			};
		};
	};
};
